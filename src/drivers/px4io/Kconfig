## src/drivers/px4io/Kconfig
```kconfig
menuconfig DRIVERS_PX4IO
	bool "px4io"
	default n
	---help---
		Enable support for px4io

menuconfig DRIVERS_PX4IO_BOARD_IO
depends on DRIVERS_PX4IO
    string "px4io IO board"
    default "px4_io-v2_default"
    help
        name of IO board to be built and included in the ROMFS (requires a valid ROMFSROOT)
```
